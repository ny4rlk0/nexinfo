//OLED SSD1106 Support
#include <U8g2lib.h>
// Reboot Support
#include "hardware/watchdog.h"

U8G2_SH1106_128X64_NONAME_F_HW_I2C u8g2(U8G2_R0);

//
int x = 128; // Start off-screen right
int contrast = 0;
const char* gpoPins[] = {"GP3","GP6","GP7","GP8"};
const char* menuItems[] = {"Home","Start","About","Reboot"};
int currentMenuPos=0;
const int buttonPins[] = {3,    6,    7,    8};
bool buttonStates[4];

// 'nexinfo_boot', 128x64px
const unsigned char epd_bitmap_nexinfo_boot [] PROGMEM = {
	0xff, 0x31, 0x00, 0x00, 0x20, 0x00, 0x00, 0x00, 0x00, 0x00, 0x00, 0x00, 0x00, 0x00, 0x00, 0x00, 
	0xd7, 0xc7, 0x01, 0x00, 0x00, 0x00, 0x00, 0x00, 0x00, 0x20, 0x00, 0x00, 0x00, 0x60, 0x00, 0x00, 
	0x23, 0xff, 0x0d, 0x00, 0x00, 0x02, 0x00, 0x00, 0x00, 0x00, 0x00, 0x00, 0x00, 0x60, 0x00, 0x00, 
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	0x00, 0x00, 0x00, 0x00, 0x00, 0x00, 0x00, 0x00, 0x00, 0x00, 0x00, 0x00, 0x00, 0x00, 0x00, 0x00
};

void setup() {
  // put your setup code here, to run once:
  pinMode(buttonPins[0], INPUT_PULLUP);  // Button connected to GND
  // Initalize OLED SCREEN
  u8g2.begin();
  // Set Brightness to Max 0-255
  u8g2.setContrast(255);
  //Set button pins to input
  for(int i=0;i<4;i++){
    pinMode(buttonPins[i],INPUT_PULLUP);
  }
  //Show boot logo for 3 seconds
  u8g2.clearBuffer();
	u8g2.drawXBMP(0, 0, 128, 64, epd_bitmap_nexinfo_boot);
  u8g2.sendBuffer();
  // Pulse contrast from 0 to 255 over 3 seconds
  unsigned long startTime = millis();
  int contrast = 0;
  int direction = 5; // Step size

  while (millis() - startTime < 6350) {
    u8g2.setContrast(contrast);
    contrast += direction;

    // Reverse direction at bounds
    if (contrast >= 255 || contrast <= 0) {
      direction = -direction;
    }
      delay(20); // Controls pulse speed
    }
    // Set Brightness to Max 0-255
    u8g2.setContrast(255);
    delay(2000); // Hold at full contrast for a moment

    //delay(3000);
  }

void loop() {
  // put your main code here, to run repeatedly:
	// GP8 UP; GP6 DOWN; GP3 LEFT; GP4 RIGHT;
  // Read button status
  for(int i = 0;i<4;i++){
    buttonStates[i]=digitalRead(buttonPins[i])==LOW;
  }
  // Clear screen
  u8g2.clearBuffer();
  // Print button status to screen
  for(int i = 0;i<4;i++){
    // Small Font
    u8g2.setFont(u8g2_font_6x10_tf);
    // Line Positioning
    u8g2.setCursor(0,12+i*12);
		if(i!=currentMenuPos){
			u8g2.print(menuItems[i]);
		}
		else if(i==currentMenuPos){
			u8g2.print("> ");
			u8g2.print(menuItems[i]);
		}
  }
	u8g2.setFont(u8g2_font_6x10_tf);
	// Line Positioning
	u8g2.setCursor(0,52);
	u8g2.print("__________________________");
	u8g2.setCursor(0,64);
	u8g2.print("Back");
	u8g2.setCursor(90,64);
	u8g2.print("Select");
  // Update screen
  u8g2.sendBuffer();


	  if (digitalRead(buttonPins[1]) == LOW) {
			if(currentMenuPos!=3){
				currentMenuPos++;
			}
			else if(currentMenuPos==3){
				currentMenuPos=0;
			}
  }
	if(currentMenuPos==1&&digitalRead(buttonPins[2]) == LOW){
		// Clear screen
		u8g2.clearBuffer();
		// Small Font
		u8g2.setFont(u8g2_font_6x10_tf);
		// Line Positioning
		u8g2.setCursor(0,12);
		u8g2.print("No software found!");
		// Update screen
		u8g2.sendBuffer();
		delay(2000);
	}
	if(currentMenuPos==2&&digitalRead(buttonPins[2]) == LOW){
		// Clear screen
		u8g2.clearBuffer();
		// Small Font
		u8g2.setFont(u8g2_font_6x10_tf);
		// Line Positioning
		u8g2.setCursor(0,12);
		u8g2.print("Nexinfo OS v0.1");
		u8g2.setCursor(0, 24);
		u8g2.print("Open Source");
		u8g2.setCursor(0, 36);
		u8g2.print("License: MIT");
		u8g2.setCursor(0, 48);
		u8g2.print("github.com/ny4rlk0");
		// Update screen
		u8g2.sendBuffer();
		delay(3000);
	}
	if (currentMenuPos==3&&digitalRead(buttonPins[2]) == LOW) {
    delay(50); // Optional debounce
    watchdog_reboot(0,0,0);
  }
	// Delay between reads
  delay(200);
}
