//OLED SSD1106 Support
#include <U8g2lib.h>
//
#include <vector>
// Reboot Support
#include "hardware/watchdog.h"
//HTTP Client Support
#include <HTTPClient.h>
//WiFi support
#include <WiFi.h>
#include <WiFiClientSecure.h>
const char* ssid = "Wi-Fi Adını Buraya Yaz";
const char* password = "Wi-Fi Şifreni Buraya Yaz";

void connectWiFi() {
  WiFi.begin(ssid, password);
  while (WiFi.status() != WL_CONNECTED) {
    delay(500);
  }
}

U8G2_SH1106_128X64_NONAME_F_HW_I2C u8g2(U8G2_R0);

//
std::vector<String> newsTitles;
int currentNewsIndex = 0;
int scrollOffset = 0;
//unsigned long lastScrollTime = 0;
const int scrollSpeed = 100; // ms

int scrollLine = 0;
unsigned long lastScrollTime = 0;
const int scrollDelay = 1000; // 1 saniyede bir satır kaydır

int x = 128; // Start off-screen right
int contrast = 0;
const char* gpoPins[] = {"GP3","GP6","GP7","GP8"};
const char* menuItems[] = {"Home","News","About","Reboot"};
const char* allMenu[] = {"Main","Program_1"};
int currentMenu =0; //0=Main Menu, 1=Program_1
int currentMenuPos=0;
const int buttonPins[] = {3,    6,    7,    8};
bool buttonStates[4];
bool isButtonPressed(int index) {
    return digitalRead(buttonPins[index]) == LOW;
}
// 'nexinfo_boot', 128x64px
const unsigned char epd_bitmap_nexinfo_boot [] PROGMEM = {
	0xff, 0x31, 0x00, 0x00, 0x20, 0x00, 0x00, 0x00, 0x00, 0x00, 0x00, 0x00, 0x00, 0x00, 0x00, 0x00, 
	0xd7, 0xc7, 0x01, 0x00, 0x00, 0x00, 0x00, 0x00, 0x00, 0x20, 0x00, 0x00, 0x00, 0x60, 0x00, 0x00, 
	0x23, 0xff, 0x0d, 0x00, 0x00, 0x02, 0x00, 0x00, 0x00, 0x00, 0x00, 0x00, 0x00, 0x60, 0x00, 0x00, 
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	0x00, 0x00, 0x00, 0x00, 0x00, 0x00, 0x00, 0x00, 0x00, 0x00, 0x00, 0x00, 0x00, 0x00, 0x00, 0x00
};

String sanitizeText(String input) {
  input.replace("ç", "c");
  input.replace("Ç", "C");
  input.replace("ğ", "g");
  input.replace("Ğ", "G");
  input.replace("ş", "s");
  input.replace("Ş", "S");
  input.replace("ü", "u");
  input.replace("Ü", "U");
  input.replace("ö", "o");
  input.replace("Ö", "O");
  input.replace("ı", "i");
  input.replace("İ", "I");
  return input;
}

void fetchNewsTitles() {
  WiFiClientSecure secureClient;
  secureClient.setInsecure();

  HTTPClient https;
  https.begin(secureClient, "https://www.trthaber.com/sondakika_articles.rss");
  int httpCode = https.GET();

  if (httpCode > 0) {
    String payload = https.getString();
    int itemPos = 0;

    while ((itemPos = payload.indexOf("<item>", itemPos)) != -1) {
      int titleStart = payload.indexOf("<title>", itemPos);
      int titleEnd = payload.indexOf("</title>", titleStart);
      if (titleStart != -1 && titleEnd != -1) {
        String title = payload.substring(titleStart + 7, titleEnd);
				title = sanitizeText(title); // Cleanup Turkish Characters lol
        newsTitles.push_back(title);
      }
      itemPos = titleEnd;
      if (newsTitles.size() >= 60) break;
    }
  }

  https.end();
}
void setup() {
  // put your setup code here, to run once:
  pinMode(buttonPins[0], INPUT_PULLUP);  // Button connected to GND
  // Initalize OLED SCREEN
  u8g2.begin();
  // Set Brightness to Max 0-255
  u8g2.setContrast(255);
  //Set button pins to input
  for(int i=0;i<4;i++){
    pinMode(buttonPins[i],INPUT_PULLUP);
  }
  //Show boot logo for 3 seconds
  u8g2.clearBuffer();
	u8g2.drawXBMP(0, 0, 128, 64, epd_bitmap_nexinfo_boot);
  u8g2.sendBuffer();
  // Pulse contrast from 0 to 255 over 3 seconds
  unsigned long startTime = millis();
  int contrast = 0;
  int direction = 5; // Step size

  while (millis() - startTime < 6350) {
    u8g2.setContrast(contrast);
    contrast += direction;

    // Reverse direction at bounds
    if (contrast >= 255 || contrast <= 0) {
      direction = -direction;
    }
      delay(20); // Controls pulse speed
    }
    // Set Brightness to Max 0-255
    u8g2.setContrast(255);
    delay(2000); // Hold at full contrast for a moment
		//Connect to Wi-Fi
		connectWiFi();
    //delay(3000);
  }

void loop() {
  // put your main code here, to run repeatedly:
	// GP8 UP; GP6 DOWN; GP3 LEFT; GP4 RIGHT;
  // Read button status
  for(int i = 0;i<4;i++){
    buttonStates[i]=isButtonPressed(buttonPins[i]);
  }
  // Clear screen
  u8g2.clearBuffer();
	//Main Menu
	if(currentMenu==0){
			// Print button status to screen
		for(int i = 0;i<4;i++){
			// Small Font
			u8g2.setFont(u8g2_font_6x10_tf);
			// Line Positioning
			u8g2.setCursor(0,12+i*12);
			if(i!=currentMenuPos){
				u8g2.print(menuItems[i]);
			}
			else if(i==currentMenuPos){
				u8g2.print("> ");
				u8g2.print(menuItems[i]);
			}
		}
		u8g2.setFont(u8g2_font_6x10_tf);
		// Line Positioning
		u8g2.setCursor(0,52);
		u8g2.print("__________________________");
		u8g2.setCursor(0,64);
		u8g2.print("Back");
		u8g2.setCursor(90,64);
		u8g2.print("Select");
		// Update screen
		u8g2.sendBuffer();


			if (isButtonPressed(1)) {
				if(currentMenuPos!=3){
					currentMenuPos++;
				}
				else if(currentMenuPos==3){
					currentMenuPos=0;
				}
		}
		if(currentMenuPos==1&&isButtonPressed(2)){
			// Clear screen
			u8g2.clearBuffer();
			// Small Font
			u8g2.setFont(u8g2_font_6x10_tf);
			// Line Positioning
			u8g2.setCursor(0,12);
			u8g2.print("Starting News!");
			// Update screen
			u8g2.sendBuffer();
			//Give User Time to Read Starting News 
			delay(2000);

			//Refresh News (RSS) Each Time User Opens News Applet
			newsTitles.clear();        // Clear old headlines
			fetchNewsTitles();         // Fetch fresh headlines
			currentNewsIndex = 0;      // Reset to first headline
			scrollLine = 0;            // Reset scroll

			//Open News Applet
			currentMenu=1;
		}
		if(currentMenuPos==2&&isButtonPressed(2)){
			// Clear screen
			u8g2.clearBuffer();
			// Small Font
			u8g2.setFont(u8g2_font_6x10_tf);
			// Line Positioning
			u8g2.setCursor(0,12);
			u8g2.print("Nexinfo OS v0.1a");
			u8g2.setCursor(0, 24);
			u8g2.print("Open Source");
			u8g2.setCursor(0, 36);
			u8g2.print("License: MIT");
			u8g2.setCursor(0, 48);
			u8g2.print("github.com/ny4rlk0");
			// Update screen
			u8g2.sendBuffer();
			delay(5000);
		}
		if (currentMenuPos==3&&isButtonPressed(2)) {
			delay(50); // Optional debounce
			watchdog_reboot(0,0,0);
		}
	}
    
  // !-- Start of News Aplet --!
	else if (currentMenu==1){
  	//If not connected to Wi-Fi Reconnect
  	if (WiFi.status() != WL_CONNECTED) {
    	WiFi.begin(ssid, password);
  		delay(3000);
  	}
    if (newsTitles.empty()) {
      fetchNewsTitles(); // Başlıkları çek, sanitize içinde
    }
  
    // Tuşa basınca sonraki habere geç
    if (isButtonPressed(1)) {
      currentNewsIndex = (currentNewsIndex + 1) % newsTitles.size();
      scrollLine = 0;
      delay(300); // debounce
    }
  
    // Başlığı al ve temizle
    String title = newsTitles[currentNewsIndex];
    int totalLines = ceil((float)title.length() / 20.0);
  
    // Sadece ekranı aşarsa scroll başlat
    if (totalLines > 6 && millis() - lastScrollTime > scrollDelay) {
      scrollLine++;
      if (scrollLine > totalLines - 6) scrollLine = 0;
      lastScrollTime = millis();
    }
  
    // Ekrana yaz
    u8g2.clearBuffer();
    u8g2.setFont(u8g2_font_6x10_tf);
  
    for (int i = 0; i < 6; i++) {
      int start = (scrollLine + i) * 20;
      if (start < title.length()) {
        String line = title.substring(start, min(start + 20, title.length()));
        u8g2.setCursor(0, 12 + i * 10);
        u8g2.print(line);
      }
    }
  
    u8g2.sendBuffer();
  	if (isButtonPressed(2)) {
  		currentMenu = 0; // Ana menüye dön
  	}
	}
  // !-- End of News Aplet --!
  
	// Delay between reads
  delay(200);
}
